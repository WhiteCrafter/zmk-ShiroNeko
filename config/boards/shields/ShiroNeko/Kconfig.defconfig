## config/boards/shields/ShiroNeko/Kconfig.defconfig
```kconfig
if SHIELD_SHIRONEKO_LEFT

# Name must be less than 16 characters long!
config ZMK_KEYBOARD_NAME
    default "Shiro Neko"

config ZMK_SPLIT_ROLE_CENTRAL
    default y

endif

if SHIELD_SHIRONEKO_LEFT || SHIELD_SHIRONEKO_RIGHT

config ZMK_SPLIT
    default y

endif
```

## config/boards/shields/ShiroNeko/Kconfig.shield
```kconfig
# No whitespace after the comma or in your part name!
config SHIELD_SHIRONEKO_LEFT
    def_bool $(shields_list_contains,ShiroNeko_left)

# No whitespace after the comma or in your part name!
config SHIELD_SHIRONEKO_RIGHT
    def_bool $(shields_list_contains,ShiroNeko_right)
```
